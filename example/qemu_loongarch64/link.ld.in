/*
 * Ark RTOS - QEMU `virt`（LoongArch64）链接脚本模板
 *
 * 本文件由 C 预处理器展开，包含的是 gen_ldconsts.py 生成的一份"只有数值
 * #define"的头文件（build/.../ldconsts.h）——那些数值来自
 * config/arkrtos_partition.h 与板级配置头，与内核其它部分同源（分区头是
 * 唯一允许出现物理地址的地方）。不直接 #include 分区头，是因为它含有 C 的
 * 编译期断言，会被原样搬进 ld 脚本导致 `syntax error`。
 *
 * 内存模型：QEMU 的 DRAM 从 0x0 起（128 MB），但低 1 MB 被固件的启动信息
 * 占用，所以镜像从 2 MB 起链接（板级配置头里定），"Flash" 与 "RAM" 都是
 * 同一片 DRAM 的两段，所以 .data 的 LMA 与 VMA 相同，不需要运行期搬运。
 */

#include "ldconsts.h"

ENTRY(_start)

/* 主栈（复位后到调度启动之间用）预留 64 KB，紧贴 RAM 顶端向低地址生长 */
__ram_end       = (CHIP_RAM_BASE + CHIP_RAM_SIZE);
__stack_reserve = (64 * 1024);

SECTIONS
{
    /* ---- 代码与只读数据：内核镜像区间 ---- */
    .text CHIP_FLASH_BASE :
    {
        KEEP(*(.text.start))          /* 复位入口必须落在分区首地址 */
        *(.text .text.*)

        /* 构造函数表。本工具链（GCC 8.3）把 __attribute__((constructor))
         * 放进 .ctors，新工具链放 .init_array —— 两种都收，start.S 在清零
         * .bss 之后逐个调用。没有这一段，utest 用例的自动登记会被
         * --gc-sections 丢掉，shell 的 `utest` 就报 "0 matched, 0 failed"，
         * 看上去全绿、其实一条用例都没跑（假绿）。 */
        . = ALIGN(8);
        __init_array_start = .;
        KEEP(*(.ctors))
        KEEP(*(.ctors.*))
        KEEP(*(SORT_BY_INIT_PRIORITY(.init_array.*)))
        KEEP(*(.init_array))
        . = ALIGN(8);
        __init_array_end = .;

        *(.rodata .rodata.*)
        *(.srodata .srodata.*)
    }

    . = ALIGN(16);
    __text_end = .;

    /* ---- 已初始化数据：内核 RAM 区间 ---- */
    . = KERNEL_RAM_BASE;
    .data : ALIGN(16)
    {
        __data_start = .;
        *(.sdata .sdata.*)            /* gp 相对寻址的小数据（-msmall-data-limit） */
        *(.data .data.*)
        . = ALIGN(16);
        __data_end = .;
    }

    /* ---- 未初始化数据（NOLOAD：不占 ELF 文件体积，由 start.S 清零） ---- */
    .bss (NOLOAD) : ALIGN(16)
    {
        __bss_start = .;
        *(.sbss .sbss.*)
        *(.bss .bss.*)
        *(COMMON)
        . = ALIGN(16);
        __bss_end = .;
    }

    /* LoongArch psABI 没有小数据基址寄存器（$r21 保留给 TLS），
     * 因此这里不提供 __global_pointer$。 */

    /* 主栈顶：RAM 末端 */
    _stack_top = __ram_end;

    /* 静态数据 + 主栈不得越过 RAM 末端 */
    ASSERT(__bss_end + __stack_reserve <= __ram_end, "RAM overflow: .bss + stack exceeds CHIP_RAM")

    /* ---- PLV3 探针页：App 的代码/数据/栈 ----
     * 单独一段、VMA == LMA == APP_BASE：QEMU 的 ELF 装载器按 p_paddr 把这段
     * 拷进 DRAM，所以 App 一上电就在自己的 2 MB 页里。这段既不在镜像区间也
     * 不在内核 RAM 区间内，内核 TLB 条目（PLV0）看不到它，全体也一样 ——
     * 只有 PLV 那份 PS=20 的条目（PLV3）指向这里。
     * 这段必须在 .bss 之后、并且这里显式给地址，否则会紧贴内核数据区。 */
    .appprobe ARKRTOS_QEMU_APP_BASE :
    {
        __appprobe_start = .;
        KEEP(*(.appprobe))
        KEEP(*(.appprobe.*))
        . = ALIGN(16);
        __appprobe_end = .;
    }

    ASSERT(__appprobe_end <= (ARKRTOS_QEMU_APP_BASE + ARKRTOS_QEMU_APP_SIZE),
           "App probe section exceeds ARKRTOS_QEMU_APP_SIZE")

    /DISCARD/ :
    {
        *(.comment)
        *(.note*)
        *(.eh_frame*)
    }
}
