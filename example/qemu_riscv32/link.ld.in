/*
 * Ark RTOS - QEMU `virt`（RISC-V RV32）链接脚本模板
 *
 * 本文件由 C 预处理器展开，包含的是 gen_ldconsts.py 生成的一份"只有数值
 * #define"的头文件（build/.../ldconsts.h）——那些数值来自
 * config/arkrtos_partition.h 与板级配置头，与内核其它部分同源（分区头是
 * 唯一允许出现物理地址的地方）。不直接 #include 分区头，是因为它含有 C 的
 * 编译期断言，会被原样搬进 ld 脚本导致 `syntax error`。
 *
 * 内存模型：QEMU 的 DRAM 从 0x80000000 起（128 MB），"Flash" 与 "RAM" 都是
 * 同一片 DRAM 的两段，所以 .data 的 LMA 与 VMA 相同，不需要运行期搬运。
 */

#include "ldconsts.h"

ENTRY(_start)

/* 主栈（复位后到调度启动之间用）预留 64 KB，紧贴 RAM 顶端向低地址生长 */
__ram_end       = (CHIP_RAM_BASE + CHIP_RAM_SIZE);
__stack_reserve = (64 * 1024);

SECTIONS
{
    /* ---- 代码与只读数据：内核镜像区间 ---- */
    .text CHIP_FLASH_BASE :
    {
        KEEP(*(.text.start))          /* 复位入口必须落在分区首地址 */
        *(.text .text.*)

        /* 构造函数表：utest 用例靠 __attribute__((constructor)) 自注册，
         * 这一段不收就会被 --gc-sections 丢掉，`utest` 于是报
         * "0 matched, 0 failed" —— 看着全绿，其实一条用例都没跑。 */
        . = ALIGN(4);
        __init_array_start = .;
        KEEP(*(.ctors))
        KEEP(*(.ctors.*))
        KEEP(*(SORT_BY_INIT_PRIORITY(.init_array.*)))
        KEEP(*(.init_array))
        . = ALIGN(4);
        __init_array_end = .;

        *(.rodata .rodata.*)
        *(.srodata .srodata.*)
    }

    . = ALIGN(16);
    __text_end = .;

    /* 镜像不得越过镜像池基址（IMAGE_POOL_BASE = CHIP_FLASH_BASE +
     * KERNEL_SIZE + CONFIG_SIZE）。本板现在没有 Flash 擦除后端，池擦不成
     * 0xFF，但这条线是布局契约：越界意味着内核占用了别人（配置区/池）的
     * 地址段，换个后端就会变成开机抹掉自己。 */
    ASSERT(__text_end <= IMAGE_POOL_BASE,
           "kernel image overruns KERNEL_SIZE: .text end is past IMAGE_POOL_BASE")

    /* ---- 跨复位崩溃日志（UNINIT） ---- */
    /* 与 STM32 工程里 gen_scatter.py 生成的 UNINIT 段同义：这块内存既不在
     * .data 也不在 .bss 里，启动代码不会碰它，于是它的内容能活过一次复位，
     * 只有掉电才丢。位置由分区头的 CRASH_LOG_BASE 唯一决定 —— 内核写的是这个
     * 符号，audit 比对的是同一个宏。NOLOAD：日志内容属于运行期状态，不占
     * ELF 文件体积。 */
    .noinit CRASH_LOG_BASE (NOLOAD) :
    {
        __noinit_start = .;
        KEEP(*(.noinit .noinit.*))
        . = ALIGN(4);
        __noinit_end = .;
    }
    ASSERT(__noinit_end <= (CRASH_LOG_BASE + CRASH_LOG_SIZE),
           "crash journal overlaps the rest of shared RAM")

    /* ---- 已初始化数据：内核 RAM 区间 ---- */
    . = KERNEL_RAM_BASE;
    .data : ALIGN(16)
    {
        __data_start = .;
        *(.sdata .sdata.*)            /* gp 相对寻址的小数据（-msmall-data-limit） */
        *(.data .data.*)
        . = ALIGN(16);
        __data_end = .;
    }

    /* ---- 未初始化数据（NOLOAD：不占 ELF 文件体积，由 start.S 清零） ---- */
    .bss (NOLOAD) : ALIGN(16)
    {
        __bss_start = .;
        *(.sbss .sbss.*)
        *(.bss .bss.*)
        *(COMMON)
        . = ALIGN(16);
        __bss_end = .;
    }

    /* gp 指向小数据区中部（±2 KB 覆盖 .sdata/.sbss），start.S 会把它装进 gp */
    PROVIDE(__global_pointer$ = __data_start + 0x800);

    /* 主栈顶：RAM 末端 */
    _stack_top = __ram_end;

    /* 静态数据 + 主栈不得越过 RAM 末端 */
    ASSERT(__bss_end + __stack_reserve <= __ram_end, "RAM overflow: .bss + stack exceeds CHIP_RAM")

    /DISCARD/ :
    {
        *(.comment)
        *(.note*)
        *(.eh_frame*)
    }
}
