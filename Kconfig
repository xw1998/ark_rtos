## config/kconfig/Kconfig.features
```kconfig
# Feature gates.  Defaults mirror arkrtos_features.h exactly; a disabled
# feature still lets kernelsrc compile (CI builds a trimmed kernel).

menu "Kernel core"

config ARKRTOS_USE_SPINLOCK
	bool "Spinlock"
	default y
	help
	  Kernel spinlock (arkrtos_spin).  Off does not remove locking: it
	  swaps in a plain interrupt-disable implementation, which is enough
	  on a single core.  The object and device tables still rely on the
	  lock semantics, so "off" means "cheaper", not "unlocked".

config ARKRTOS_USE_SCHED_LOCK
	bool
	default y
	help
	  Scheduler lock (SVC 0x1B lock/unlock).  Mandatory: the lock has no
	  honest fallback, so arkrtos_features.h rejects anything but 1.

config ARKRTOS_USE_STACK_USAGE
	bool "Task stack usage statistics"
	default y
	help
	  Fill pattern plus lowest-stack-pointer watermark, giving each task's
	  peak stack use.

config ARKRTOS_USE_STACK_CHECK
	bool "Stack overflow detection"
	default y
	help
	  Detect a stack overflow by the end-of-stack flag being overwritten.

config ARKRTOS_USE_SCHED_STAT
	bool "Scheduler statistics"
	default y
	help
	  Per-task switch count and time.

config ARKRTOS_USE_CPU_LOAD
	bool "CPU load statistics"
	default y
	help
	  Real-time idle ratio.

config ARKRTOS_USE_FAST_TICK_SWITCH
	bool "On-demand PendSV on tick"
	default y
	help
	  Skip the context-switch interrupt on a tick when no higher-priority
	  task became ready.  Measured at roughly half the tick overhead.

config ARKRTOS_USE_FAULT_RECOVER
	bool "Faulting task recovery"
	default y
	help
	  Reclaim a task slot and its resources when its exception handler runs.

config ARKRTOS_USE_MPU_APPLY_CACHE
	bool "MPU context apply cache"
	default y
	help
	  Skip rewriting the MPU registers when a task re-enters unchanged.

endmenu

menu "Synchronisation and IPC"

config ARKRTOS_USE_MQ
	bool "Message queues (SVC 0x16)"
	default y
	help
	  Semaphores, mutexes, condition variables and event groups are kernel
	  core and have no off switch here: the device framework, the POSIX
	  layer and the loader are built on them, so turning them off would
	  cascade.  Message queues are the optional one.

config ARKRTOS_USE_MEMPOOL
	bool "Fixed-block memory pool"
	default y
	help
	  arkrtos_mempool: a non-fragmenting pool whose backing store the
	  caller supplies.  Long-running components that must not depend on a
	  heap (loader staging, future socket requests) use it.

config ARKRTOS_USE_TIMER
	bool "Software timers (SVC 0x17)"
	default y

endmenu

menu "Services and components"

config ARKRTOS_USE_LOG
	bool "Kernel log"
	default y
	help
	  The shell `log` command depends on this; it disappears with the log.

config ARKRTOS_USE_LOG_RING
	bool "Kernel log ring (dmesg)"
	default y
	depends on ARKRTOS_USE_LOG
	help
	  Keep the most recent ARKRTOS_LOG_RING_SIZE bytes of formatted log
	  lines in a ring so the `dmesg` command can print them after the
	  fact.  Off compiles the ring out entirely (no RAM, no code).

config ARKRTOS_USE_BLK
	bool "Block layer"
	default y
	help
	  Device registry and the thin layer between it and the file system.

config ARKRTOS_USE_FS
	bool "File system facade + littlefs (SVC 0x1C)"
	default y
	depends on ARKRTOS_USE_BLK

config ARKRTOS_USE_VFS
	bool "Linux-style path namespace"
	default y
	depends on ARKRTOS_USE_BLK
	help
	  / is ramfs, /dev mirrors the device registry, /mnt/<name> is a
	  persistent volume.  With this off the facade still exists (it
	  returns NOSYS) but no kernel resource is reachable by path.

config ARKRTOS_USE_PROCFS
	bool "Kernel state filesystem /proc"
	default y
	depends on ARKRTOS_USE_VFS
	help
	  Read-only, flat: version / uptime / meminfo / cpuinfo / tasks are
	  rendered from the kernel on each read and mounted at /proc.  It is a
	  mount point in the VFS namespace, so it needs ARKRTOS_USE_VFS.

config ARKRTOS_USE_VFS_LFS
	bool "littlefs backend for /mnt"
	default y
	depends on ARKRTOS_USE_VFS && ARKRTOS_USE_FS

config ARKRTOS_USE_MINIAPP
	bool "MiniApps"
	default y
	depends on ARKRTOS_USE_FS
	help
	  Load a payload from the file system into RAM on demand and run it,
	  returning the RAM when it stops.  Reuses the App image container and
	  App SDK but does not enter the image pool or take a slot.

config ARKRTOS_MINI_EXIT_IS_HANDOVER
	bool "MiniApp clean exit counts as handover"
	default y
	depends on ARKRTOS_USE_MINIAPP
	help
	  A MiniApp main task returning normally is a planned handover, so the
	  hardware-safe-state mechanism only drops the bookkeeping and does not
	  drive the hardware (the soon-to-open replacement would be jittered).
	  Off makes a clean exit behave like every other task: the device is
	  driven to its safe state.  Only the clean-exit path is affected;
	  crashes, kills and fault recovery always neutralise fully.
	  Only meaningful with ARKRTOS_USE_MINIAPP.

config ARKRTOS_MINI_YIELD_CHUNKS
	int "MiniApp load: yield every N chunks (0 = never)"
	default 1
	range 0 1024
	depends on ARKRTOS_USE_MINIAPP
	help
	  While a MiniApp is loading, release and retake the scheduler lock
	  every N chunks so a higher-priority task (a control loop) gets the
	  CPU between reads.  A single chunk read is atomic under the lock, so
	  releasing it cannot let two loaders interleave.  0 keeps the lock
	  for the whole load, exactly as before this option existed.

config ARKRTOS_USE_POSIX
	bool "POSIX / Windows compatibility layer"
	default y
	help
	  pthread / dirent / file POSIX names on top of the native oslib.

config ARKRTOS_POSIX_WRAP_STDLIB
	bool "POSIX layer wraps malloc/free"
	default n

config ARKRTOS_USE_MDK_TRACE
	bool "MDK trace capture"
	default y
	help
	  components/mdk_trace; needs DWT/ITM hardware.

config ARKRTOS_USE_CM_BACKTRACE
	bool "cm_backtrace fault traceback"
	default y
	help
	  components/cm_backtrace; needs DWT/NVIC.

config ARKRTOS_USE_SOFTBUS
	bool "Software bus (components/ark_softbus)"
	default n
	help
	  Cross-device event / remote-call / data-plane bus.  The component is
	  a synced copy of the ark_softbus repository; the kernel side wires
	  the board hooks, an in-board loopback link and the `bus` console
	  command.  Off compiles no bus code at all.  Enabling it also needs
	  the per-MCU -DARK_BUS_* set in the project, or arkrtos_softbus.h
	  fails the build with #error instead of quietly taking defaults.

endmenuconfig ARKRTOS_USE_CM_BACKTRACE
	bool "cm_backtrace fault traceback"
	default y
	help
	  components/cm_backtrace; needs DWT/NVIC.

endmenu

menu "Shell"

config ARKRTOS_SHELL_GLOB
	bool "Shell glob expansion (unquoted * and ?)"
	default y
	help
	  Expand an unquoted word that contains '*' or '?' against the VFS
	  namespace, the way a POSIX shell does.  A quoted pattern is left
	  alone, a pattern that matches nothing stays literal, and a match
	  set that does not fit is reported instead of truncated.  Off makes
	  '*' and '?' ordinary characters again.

config ARKRTOS_SHELL_PROMPT_LINUX
	bool "Linux-style prompt (user@host:cwd$)"
	default y
	help
	  Draw the prompt as ark@arkrtos:<cwd>$ and give the shell a working
	  directory (cd / pwd) with Linux relative-path handling.  Off falls
	  back to the plain "ark> " prompt with no working directory.

config ARKRTOS_SHELL_REDIRECT
	bool "Shell operators: quotes, ; && ||, | pipe, > >> < redirect"
	default y
	help
	  Parse the input line the way a POSIX shell does: quotes and
	  backslash escapes, command sequences (; && ||), pipelines (|)
	  and file redirection (>, >>, <).  A pipeline runs
	  store-and-forward through a RAM buffer, so a stage whose output
	  does not fit the buffer fails loudly instead of being silently
	  truncated.  Off leaves the plain whitespace split, and the
	  operators are then ordinary characters.

config ARKRTOS_SHELL_REDIRECT_BUF
	int "Redirect / pipeline capture buffer (bytes per slot)"
	depends on ARKRTOS_SHELL_REDIRECT
	default 1024
	range 128 8192
	help
	  Size of each of the two capture buffers a pipeline alternates
	  between.  Both live in the kernel RAM window; a board with a
	  tight budget lowers this, or turns ARKRTOS_SHELL_REDIRECT off
	  in its project file (-DARKRTOS_SHELL_REDIRECT=0).

endmenu

menu "Reliability and operations"

config ARKRTOS_USE_IMAGE_SIGN
	bool "Image digital signature (HMAC-SHA256)"
	default n
	help
	  Verify the image signature at install time.  Requires a 32-byte
	  pre-shared key ARKRTOS_IMAGE_SIGN_KEY, supplied by the project (-D).
	  Symmetric by design: this is tamper detection plus provenance, not a
	  full trust chain.

config ARKRTOS_USE_CRASH_LOG
	bool "Cross-reset crash journal"
	default y

config ARKRTOS_USE_KERNEL_GUARD
	bool "Heartbeat contract and watchdog guard"
	default y
	help
	  Really bites only when the board sets ARKRTOS_WDG_ENABLE.

config ARKRTOS_USE_AUDIT
	bool "Structural self-check"
	default y
	help
	  Partition table / slot / image header consistency checks and an
	  audit record.  Off keeps the loader's minimal legality checks only.

config ARKRTOS_HW_SAFE
	bool "Hardware safe state on task death (last words)"
	default n
	help
	  A driver may register a neutralise callback declaring "when my owner
	  dies, bring this device back to a safe state" (stop a motor PWM, drop
	  a relay).  The kernel keeps a per-task ownership ledger and runs the
	  callback from the kernel - not from the crashing App - when the task
	  dies, is killed or is fault-recovered.  Off leaves the device
	  open/close and task-death paths exactly as before.

config ARKRTOS_USE_UTEST
	bool "On-board unit test framework"
	default y
	help
	  arkrtos_utest: cases self-register (constructor) and assertions are
	  accounted, not aborted; the shell gains the `utest` command.  Off
	  compiles the framework and the command out entirely.  Auto
	  registration needs constructor support (armclang / GCC).

endmenuconfig ARKRTOS_USE_AUDIT
	bool "Structural self-check"
	default y
	help
	  Partition table / slot / image header consistency checks and an
	  audit record.  Off keeps the loader's minimal legality checks only.

endmenu
```

## config/kconfig/Kconfig.posix
```kconfig
# POSIX / Windows compatibility layer capacities (kernelsrc/sdk/posix).

menu "POSIX layer"

config ARKRTOS_POSIX_THREAD_MAX
	int "Threads per process"
	default 2
	range 1 32

config ARKRTOS_POSIX_STACK_WORDS
	int "Default thread stack (words)"
	default 256
	range 64 4096

config ARKRTOS_POSIX_HEAP_SIZE
	int "POSIX heap (bytes)"
	default 1024
	range 128 1048576

config ARKRTOS_POSIX_KEY_MAX
	int "Thread-specific data keys"
	default 8
	range 1 256

config ARKRTOS_POSIX_NAME_MAX
	int "File name length"
	default 32
	range 8 255

config ARKRTOS_POSIX_DIR_MAX
	int "Open directory streams"
	default 2
	range 1 32

config ARKRTOS_POSIX_FD_MAX
	int "File descriptors"
	default 8
	range 1 64

endmenu
```
