## config/kconfig/Kconfig.net
```kconfig
# lwIP port capacities (kernelsrc/include/arkrtos_net*.h).
#
# The lwIP sources themselves are conditional-compiled by the port layer only;
# ARKRTOS_USE_LWIP gates that port.  These numbers size the Ark RTOS side.

menu "Network"

config ARKRTOS_USE_LWIP
	bool "lwIP TCP/IP stack + Ark RTOS port"
	default n
	depends on ARKRTOS_USE_MQ
	help
	  The lwIP sources are not conditional-compiled; this gate only
	  controls the port layer, so off means no port is built and the
	  socket SVCs return NOSYS.  On its own this gives a loopback netif
	  only (127.0.0.1); real Ethernet frames need ARKRTOS_USE_NET_VIRTIO
	  as well.  It is large (about 2.5 MB of sources, tens of KB of
	  static RAM), so it defaults off and is turned on per project with -D.

config ARKRTOS_USE_NET_VIRTIO
	bool "Real Ethernet NIC: virtio-net over PCI (polling)"
	depends on ARKRTOS_USE_LWIP
	default n
	help
	  Adds board/<board>/drvnet.c and the lwIP link layer, so that the
	  stack is fed by a real Ethernet controller instead of the loopback
	  netif.  Frames really leave and enter the chip: ARP, ICMP and TCP
	  all traverse real Ethernet frames.

	  The only implementation today is virtio-net over PCI on QEMU
	  loongarch64 virt (modern 1.0 interface, polled - this port has no
	  PCI interrupt controller wired up).  It proves the kernel can drive
	  a real Ethernet controller; the PHY / MDIO / RMII path is still
	  outstanding and needs a real board.

	  Requires ARKRTOS_USE_LWIP=y.  Off by default: nothing is compiled
	  and the image is unchanged.

config ARKRTOS_NET_MAX_SOCKETS
	int "Simultaneous sockets"
	default 4
	range 1 64

config ARKRTOS_NET_TASK_STACK_WORDS
	int "Network service task stack (words)"
	default 1024
	range 128 4096
	help
	  The service task runs real lwIP functions (lwip_recvfrom / lwip_send /
	  lwip_accept), whose call depth we do not control: netconn -> api_msg ->
	  a synchronous message to the tcpip thread. 384 words (1.5 KB) overflows
	  on LA64: QEMU shows "stack bottom flag overwritten" for the service task
	  and the pending recv then never answers, which the caller sees as "no
	  data ever arrives" rather than as an error code. 4 KB measured enough.

endmenu
```
